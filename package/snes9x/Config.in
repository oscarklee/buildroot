## package/snes9x/Config.in
```kconfig
config BR2_PACKAGE_SNES9X
	bool "snes9x"
	depends on BR2_PACKAGE_SDL2
	depends on BR2_INSTALL_LIBSTDCPP
	depends on BR2_USE_WCHAR
	depends on BR2_TOOLCHAIN_HAS_THREADS
	select BR2_PACKAGE_ZLIB
	select BR2_PACKAGE_LIBPNG
	select BR2_PACKAGE_ALSA_LIB
	help
	  Super Nintendo Entertainment System emulator

	  https://github.com/snes9xgit/snes9x

comment "snes9x needs SDL2 and a toolchain w/ wchar, threads, C++"
	depends on !BR2_PACKAGE_SDL2 || !BR2_INSTALL_LIBSTDCPP || \
		!BR2_USE_WCHAR || !BR2_TOOLCHAIN_HAS_THREADS
```
